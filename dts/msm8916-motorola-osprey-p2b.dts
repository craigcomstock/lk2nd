/* Copyright (c) 2014-2015, Motorola Mobility LLC. All rights reserved.
*
* This program is free software; you can redistribute it and/or modify
* it under the terms of the GNU General Public License version 2 and
* only version 2 as published by the Free Software Foundation.
*
* This program is distributed in the hope that it will be useful,
* but WITHOUT ANY WARRANTY; without even the implied warranty of
* MERCHANTABILITY or FITNESS FOR A PARTICULAR PURPOSE.  See the
* GNU General Public License for more details.
*/

/dts-v1/;

/include/ "msm8916.dtsi"
/include/ "motorola-carrier-channel-ids.dtsi"

/ {
	compatible = "qcom,msm8916";
	qcom,msm-id =	<206 0>,
			<248 0>,
			<249 0>,
			<250 0>;
	qcom,board-id = <0x4a 0x82b0>;

	model = "Motorola Moto G 2015 (osprey)";
	compatible = "motorola,harpia", "qcom,msm8916", "lk2nd,device";
};
